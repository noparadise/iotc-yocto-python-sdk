## meta-iotc-python-sdk/conf/layer.conf
```bitbake
# We have a conf and classes directory, add to BBPATH
BBPATH .= ":${LAYERDIR}"

# We have recipes-* directories, add to BBFILES
BBFILES += "${LAYERDIR}/recipes-*/*/*.bb \
            ${LAYERDIR}/recipes-*/*/*.bbappend"

BBFILE_COLLECTIONS += "meta-iotc-python-sdk"
BBFILE_PATTERN_meta-iotc-python-sdk = "^${LAYERDIR}/"
BBFILE_PRIORITY_meta-iotc-python-sdk = "6"

LAYERDEPENDS_meta-iotc-python-sdk = "core"
LAYERSERIES_COMPAT_meta-iotc-python-sdk = "kirkstone"

IMAGE_INSTALL:append = " python3"
IMAGE_INSTALL:append = " screen"
#IMAGE_INSTALL_append = " python3_3.7.9"
```

## meta-my-iotc-python-sdk-example/conf/layer.conf
```bitbake
# We have a conf and classes directory, add to BBPATH
BBPATH .= ":${LAYERDIR}"

# We have recipes-* directories, add to BBFILES
BBFILES += "${LAYERDIR}/recipes-*/*/*.bb \
            ${LAYERDIR}/recipes-*/*/*.bbappend"

BBFILE_COLLECTIONS += "meta-my-iotc-python-sdk-example"
BBFILE_PATTERN_meta-my-iotc-python-sdk-example = "^${LAYERDIR}/"
BBFILE_PRIORITY_meta-my-iotc-python-sdk-example = "6"

LAYERDEPENDS_meta-my-iotc-python-sdk-example = "core"
LAYERSERIES_COMPAT_meta-my-iotc-python-sdk-example = "kirkstone"
```
